#include <stdio.h>
#include <string.h>
#include "boards.h"
#include "app_util_platform.h"
#include "app_error.h"
#include "nrf_drv_twi.h"
#include "nrf_delay.h"
#include "nrf_gpio.h"
#include "SEGGER_RTT.h"

#define TWI_INSTANCE_ID 0

#define OLED_I2C_ADDRESS 0x3c

#define WIDTH  128
#define HEIGHT 32

#define RST_PIN 24
#define SCL_PIN 22
#define SDA_PIN 21


static const nrf_drv_twi_t m_twi = NRF_DRV_TWI_INSTANCE(TWI_INSTANCE_ID);

uint8_t buffer[] = {
  // Bitmap borrowed from https://github.com/lexus2k/ssd1306/blob/master/examples/direct_draw/draw_bitmap/draw_bitmap.ino

  // Page 1
  0x00, 0x00, 0x00, 0x00, 0x00, 0x00, 0x00, 0x00, 0x00, 0x00, 0x00, 0x00, 0x00, 0x00, 0x00, 0x00,
  0x00, 0x00, 0x00, 0x00, 0x00, 0x00, 0x00, 0x00, 0x00, 0x00, 0x00, 0x00, 0x00, 0x00, 0x00, 0x00,
  0x00, 0x00, 0x00, 0x00, 0x00, 0x00, 0x00, 0x00, 0x00, 0x00, 0x00, 0x00, 0x00, 0x00, 0x00, 0x00,
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  0x00, 0x00, 0x00, 0x00, 0x00, 0x00, 0x00, 0x00, 0x00, 0x00, 0x00, 0x00, 0x00, 0x00, 0x00, 0x00,

  // Page 2
  0x00, 0x00, 0x00, 0x00, 0x00, 0x00, 0x00, 0x00, 0x00, 0x00, 0x00, 0x00, 0x00, 0x00, 0x00, 0x00,
  0x00, 0x00, 0x00, 0x00, 0x00, 0x00, 0x00, 0x00, 0x00, 0x00, 0x00, 0x00, 0x00, 0x00, 0x00, 0x00,
  0x00, 0x00, 0x00, 0x80, 0x80, 0x80, 0x00, 0x00, 0x00, 0x00, 0x00, 0x00, 0x00, 0x00, 0x00, 0x00,
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  0x00, 0x00, 0x00, 0x00, 0x00, 0x00, 0x00, 0x00, 0x00, 0x00, 0x00, 0x00, 0x00, 0x00, 0x00, 0x00,

  // Page 3
  0xff, 0x08, 0x08, 0xff, 0x00, 0x00, 0xff, 0x00, 0x00, 0x8f, 0x00, 0x00, 0x00, 0x00, 0x00, 0x00,
  0x00, 0x00, 0x00, 0x00, 0x00, 0x00, 0x00, 0x00, 0x00, 0x00, 0x00, 0x00, 0x00, 0x80, 0xE0, 0x30,
  0x98, 0xDE, 0xE6, 0xE7, 0xF7, 0xD7, 0xD6, 0x56, 0x56, 0xD7, 0xD7, 0x5F, 0xDF, 0x3F, 0x3F, 0x2F,
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  0x00, 0x00, 0x00, 0x00, 0x00, 0x00, 0x00, 0x00, 0x00, 0x00, 0x00, 0x00, 0x00, 0x00, 0x00, 0x00,

  // Page 4
  0x00, 0x00, 0x00, 0x00, 0x00, 0x00, 0x00, 0x00, 0x00, 0x00, 0x00, 0x00, 0x00, 0x00, 0x00, 0x00,
  0x00, 0x00, 0x00, 0x00, 0x00, 0x00, 0x00, 0x00, 0x00, 0x00, 0x00, 0x00, 0x00, 0x03, 0xFB, 0xE0,
  0xDF, 0xB1, 0xEF, 0x5F, 0xB9, 0xB0, 0xA0, 0xE6, 0x6E, 0x2E, 0xB6, 0xB9, 0x9F, 0xAF, 0xA0, 0xA7,
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  0x00, 0x00, 0x00, 0x00, 0x00, 0x00, 0x00, 0x00, 0x00, 0x00, 0x00, 0x00, 0x00, 0x00, 0x00, 0x00,

  // Page 5
  0x00, 0x00, 0x00, 0x00, 0x00, 0x00, 0x00, 0x00, 0x00, 0x00, 0x00, 0x00, 0x00, 0x00, 0x00, 0x00,
  0x00, 0x00, 0x00, 0x00, 0x00, 0x00, 0x00, 0x00, 0x00, 0x00, 0x00, 0x0F, 0x1F, 0x3F, 0x3C, 0x73,
  0xEF, 0x9E, 0x7E, 0xFD, 0xFD, 0xED, 0xAD, 0xFD, 0xDD, 0xFF, 0xBF, 0xFF, 0x5F, 0xDF, 0xEF, 0xFF,
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  0x60, 0x60, 0x00, 0x00, 0x00, 0x00, 0x00, 0x00, 0x00, 0x00, 0x00, 0x00, 0x00, 0x00, 0x00, 0x00,
};

void twi_init (void)
{
    ret_code_t err_code;

    const nrf_drv_twi_config_t twi_config = {
       .scl                = SCL_PIN,
       .sda                = SDA_PIN,
       .frequency          = NRF_TWI_FREQ_100K,
       .interrupt_priority = APP_IRQ_PRIORITY_HIGH,
       .clear_bus_init     = false,
    };

    err_code = nrf_drv_twi_init(&m_twi, &twi_config, NULL, NULL);
    APP_ERROR_CHECK(err_code);

    nrf_drv_twi_enable(&m_twi);
}

void send_cmd(uint8_t byte) {
    uint8_t dta_send[] = {0x00, byte};
    nrf_drv_twi_tx(&m_twi, OLED_I2C_ADDRESS, dta_send, 2, false);
}

void send_data(uint8_t byte) {
    uint8_t dta_send[] = {0x40, byte};
    nrf_drv_twi_tx(&m_twi, OLED_I2C_ADDRESS, dta_send, 2, false);
}

void set_position_origin() {
  uint8_t cmds[] = {
    0x21, 0, WIDTH-1,
    0x22, 0x00, 0x03,
  };

  for (int i = 0; i < sizeof(cmds); i++) {
    send_cmd(cmds[i]);
  }

}

void clear_screen() {
    uint8_t buffer[WIDTH + 1];

    // Signal that it's data that's coming next
    buffer[0] = 0x40;

    memset(buffer + 1, 0x00, WIDTH);

    for (uint16_t page=0; page<4; page++) {
      nrf_drv_twi_tx(&m_twi, OLED_I2C_ADDRESS, buffer, WIDTH+1, true);
    }
}

void draw_pattern(bool slow) {
    uint8_t local_buffer[WIDTH + 1];
    memset(local_buffer, 0xff, WIDTH + 1);

    // Signal that it's data that's coming next
    local_buffer[0] = 0x40;

    for (uint8_t page=1; page<5; page++) {
      int init = page*WIDTH;

      for (int i=0; i<WIDTH; i++) {
        if (i%2 == 0) {
          local_buffer[1 + 1*16 + i/2] = buffer[init + i];
        } else {
          local_buffer[1 + 5*16 + i/2] = buffer[init + i];
        }
      }

      if (!slow) {
        nrf_drv_twi_tx(&m_twi, OLED_I2C_ADDRESS, local_buffer, WIDTH+1, false);
      } else {
        for (uint8_t i=0; i<WIDTH; i++) {
          uint8_t data[] = {0x40, local_buffer[i+1]};
          nrf_drv_twi_tx(&m_twi, OLED_I2C_ADDRESS, data, 2, false);
          nrf_delay_ms(10);
        }
      }
    }
}

int main(void)
{
    SEGGER_RTT_WriteString(0, "OLED test.\r\n");

    twi_init();

    // RES# dance
    nrf_gpio_cfg_output(RST_PIN);
    nrf_delay_ms(40);
    nrf_gpio_pin_set(RST_PIN);
    nrf_delay_ms(1);
    nrf_gpio_pin_clear(RST_PIN);
    nrf_delay_ms(10);
    nrf_gpio_pin_set(RST_PIN);

    uint8_t cmds[] = {
      0xae,       // display off
      0xd5, 0x80,
      0xa8, HEIGHT-1,
      0xd3, 0x00,
      0x40,
      0x8d, 0x14,
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      0xaf,       //display on
    };

    for (int i = 0; i < sizeof(cmds); i++) {
      send_cmd(cmds[i]);
    }

    set_position_origin();
    clear_screen();
    set_position_origin();
    draw_pattern(true);

    while (true);
}
